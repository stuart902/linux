## Documentation/devicetree/bindings/power/supply/apple,tristar-charger.yaml
```yaml
# SPDX-License-Identifier: GPL-2.0-only OR BSD-2-Clause
%YAML 1.2
---
$id: http://devicetree.org/schemas/power/supply/apple,tristar-charger.yaml#
$schema: http://devicetree.org/meta-schemas/core.yaml#

title: Apple Tristar Lightning charging

maintainers:
  - Henrik Klee <henrik@goat-code.com>

description: |
  Charging on Apple devices whose Lightning port uses a Tristar (NXP CBTL1610)
  port controller and a D2365-family PMIC, such as the iPad 5 and iPad 6. The
  node is a child of the PMIC. It identifies the attached source through the
  Tristar and the PMIC ADC and sets the PMIC input-current limit, which iBoot
  leaves at 100 mA. PMU events come from the PMIC's event interrupt
  controller (the PMIC GPIO node).

allOf:
  - $ref: power-supply.yaml#

properties:
  compatible:
    items:
      - enum:
          - apple,j71b-tristar-charger
          - apple,j71t-tristar-charger
      - const: apple,tristar-charger

  reg:
    items:
      - description: Charger status register bank.
      - description: Charger control register bank.
      - description: ADC register bank.

  reg-names:
    items:
      - const: status
      - const: control
      - const: adc

  interrupts:
    minItems: 3
    maxItems: 16
    description: |
      From the PMIC's event interrupt controller. The first is the PMU event
      line itself, which runs before the events are read: the charger
      withdraws a grant there, before it knows which event it was. The
      second is ADC conversion complete. Every further entry is an event
      that can signal a change of the attached source (attach, detach,
      charger state); any of them starts a new identification.

  apple,tristar:
    $ref: /schemas/types.yaml#/definitions/phandle
    description: The Tristar (CBTL1610) port controller on its I2C bus.

  input-current-limit-microamp:
    description: Board maximum input current.

required:
  - compatible
  - reg
  - reg-names
  - interrupts
  - apple,tristar
  - input-current-limit-microamp

unevaluatedProperties: false

examples:
  - |
    #include <dt-bindings/interrupt-controller/irq.h>

    i2c {
        #address-cells = <1>;
        #size-cells = <0>;

        tristar: port-controller@1a {
            compatible = "nxp,cbtl1610";
            reg = <0x1a>;
        };
    };

    pmic {
        #address-cells = <1>;
        #size-cells = <1>;

        pmu_gpio: gpio {
            compatible = "apple,d2365-pmic-gpio";
            gpio-controller;
            #gpio-cells = <2>;
            interrupt-controller;
            #interrupt-cells = <2>;
            interrupts = <38 IRQ_TYPE_LEVEL_LOW>;
        };

        charger@180 {
            compatible = "apple,j71b-tristar-charger", "apple,tristar-charger";
            reg = <0x180 0x10>, <0xa00 0x04>, <0x4000 0x03>;
            reg-names = "status", "control", "adc";
            interrupt-parent = <&pmu_gpio>;
            interrupts = <240 IRQ_TYPE_EDGE_RISING>,
                         <176 IRQ_TYPE_EDGE_RISING>,
                         <16 IRQ_TYPE_EDGE_RISING>,
                         <40 IRQ_TYPE_EDGE_RISING>,
                         <41 IRQ_TYPE_EDGE_RISING>,
                         <42 IRQ_TYPE_EDGE_RISING>,
                         <43 IRQ_TYPE_EDGE_RISING>,
                         <72 IRQ_TYPE_EDGE_RISING>,
                         <77 IRQ_TYPE_EDGE_RISING>;
            apple,tristar = <&tristar>;
            input-current-limit-microamp = <2400000>;
        };
    };
...
```

## Documentation/devicetree/bindings/soc/apple/apple,t8010-aop.yaml
```yaml
# SPDX-License-Identifier: (GPL-2.0-only OR BSD-2-Clause)
%YAML 1.2
---
$id: http://devicetree.org/schemas/soc/apple/apple,t8010-aop.yaml#
$schema: http://devicetree.org/meta-schemas/core.yaml#

title: Apple S8000 and T8010 Always-On Processor

maintainers:
  - Dalton Alexandre <alley.nightly_0b@icloud.com>

description:
  The Always-On Processor (AOP) of the A9 and A10 is an ARMv7 coprocessor
  that runs RTKit firmware and serves the motion sensors (accelerometer,
  gyroscope, compass, pressure) and the always-on microphones. It runs from
  local SRAM, with a further firmware segment in system memory, and talks
  to the application processor through an A7 IOP mailbox. Its firmware is
  board-specific and is loaded by the operating system.

properties:
  compatible:
    enum:
      - apple,s8000-aop
      - apple,t8010-aop

  reg:
    items:
      - description: AKF coprocessor control registers
      - description: Always-on boot control registers
      - description: Local SRAM

  reg-names:
    items:
      - const: akf
      - const: control
      - const: sram

  mboxes:
    maxItems: 1

  mbox-names:
    const: mbox

  firmware-name:
    items:
      - description: Main image, loaded into the local SRAM
      - description: External segment, loaded into system memory

  apple,ecid:
    $ref: /schemas/types.yaml#/definitions/uint64
    description:
      The chip's unique ID (ECID), filled in by the bootloader. The
      firmware's boot arguments carry it.

  apple,aop-target:
    $ref: /schemas/types.yaml#/definitions/uint32
    description:
      The AOP target number from the Apple device tree, filled in by the
      bootloader. The S8000 firmware's boot arguments carry it.

  apple,chip-id:
    $ref: /schemas/types.yaml#/definitions/uint32
    description:
      The SoC's chip ID (e.g. 0x8003), filled in by the bootloader. The S8000
      firmware's boot arguments carry it.

  apple,chip-revision:
    $ref: /schemas/types.yaml#/definitions/uint32
    description:
      The SoC's chip revision, filled in by the bootloader. The S8000
      firmware's boot arguments carry it.

patternProperties:
  "^(accel|gyro|compass|pressure)$":
    type: object
    description:
      A sensor served by the AOP firmware, named like the firmware's service.
    properties:
      compatible:
        enum:
          - apple,s8000-aop-accel
          - apple,s8000-aop-gyro
          - apple,s8000-aop-pressure
          - apple,t8010-aop-accel
          - apple,t8010-aop-gyro
          - apple,t8010-aop-compass
          - apple,t8010-aop-pressure

      mount-matrix:
        description: The sensor's mounting rotation in the device.

    patternProperties:
      "^apple,(low-temp-accel-offset|(accel|gyro)-(sensitivity|interrupt)-calibration|(accel|gyro)-range-sensitivity-cal|gyro-trim-calibration|pressure-(offset-calibration|accel-sensitivity|heater-resistance))$":
        $ref: /schemas/types.yaml#/definitions/uint8-array
        maxItems: 64
        description:
          The unit's factory calibration of the sensor, copied by the
          bootloader from the property of the same name (without the
          prefix) in the Apple device tree. The driver hands it to the
          firmware as a property of the sensor's service.

    required:
      - compatible
    additionalProperties: false

required:
  - compatible
  - reg
  - reg-names
  - mboxes
  - mbox-names
  - firmware-name

additionalProperties: false

examples:
  - |
    soc {
        #address-cells = <2>;
        #size-cells = <2>;

        aop@210800000 {
            compatible = "apple,t8010-aop";
            reg = <0x2 0x10800000 0x0 0x4000>,
                  <0x2 0x10000500 0x0 0x100>,
                  <0x2 0x10e00000 0x0 0xa0000>;
            reg-names = "akf", "control", "sram";
            mboxes = <&aop_mbox>;
            mbox-names = "mbox";
            firmware-name = "apple/aop-ipad7b.bin", "apple/aop-ipad7b-ext.bin";

            accel {
                compatible = "apple,t8010-aop-accel";
            };
        };
    };
```

## Documentation/devicetree/bindings/sound/apple,j71b-audio.yaml
```yaml
# SPDX-License-Identifier: (GPL-2.0-only OR BSD-2-Clause)
%YAML 1.2
---
$id: http://devicetree.org/schemas/sound/apple,j71b-audio.yaml#
$schema: http://devicetree.org/meta-schemas/core.yaml#

title: Apple J71b speaker audio link

maintainers:
  - Stuart Fraser <stuart902@users.noreply.github.com>

description: |
  The J71b speaker amplifier bank shares a reset line and receives audio
  from MCA2. The current qualification driver keeps reset asserted and
  exposes the recovered four-channel digital transport only. No physical
  speaker channel positions or acoustic gain policy are implied.

properties:
  compatible:
    const: apple,j71b-audio

  audio-cpu:
    $ref: /schemas/types.yaml#/definitions/phandle
    description: MCA2 CPU audio interface.

  reset-gpios:
    maxItems: 1
    description: Shared active-low amplifier reset on AP GPIO20.

required:
  - compatible
  - audio-cpu
  - reset-gpios

additionalProperties: false
```

## Documentation/devicetree/bindings/sound/apple,s8000-mca.yaml
```yaml
# SPDX-License-Identifier: (GPL-2.0-only OR BSD-2-Clause)
%YAML 1.2
---
$id: http://devicetree.org/schemas/sound/apple,s8000-mca.yaml#
$schema: http://devicetree.org/meta-schemas/core.yaml#

title: Apple S8000/T8010 MCA I2S controller

maintainers:
  - Berkay Kösebay <brkosebay@users.noreply.github.com>

description: |
  The "mca-version 4" serializer of the Apple A9. Each MCA has a register
  window and a 32-bit MCLK control word, which the driver exports as the
  clock feeding the codec's MCLK. Its pads are connected to the outside
  through the i2s-switch, a routing block shared by all MCAs. Samples are
  moved by SmartIO DMA. T8010 uses the same register layout (version 5),
  with an AP NCO bitclock for the playback-only digital speaker path.

allOf:
  - $ref: dai-common.yaml#
  - if:
      properties:
        compatible:
          const: apple,t8010-mca
    then:
      properties:
        dmas:
          maxItems: 1
        dma-names:
          maxItems: 1
      required:
        - clocks
        - clock-names
    else:
      properties:
        clocks: false
        clock-names: false

properties:
  compatible:
    enum:
      - apple,s8000-mca
      - apple,t8010-mca

  clocks:
    maxItems: 1
    description: AP NCO channel supplying the T8010 bitclock

  clock-names:
    const: bitclk

  reg:
    items:
      - description: MCA registers
      - description: MCLK control word

  reg-names:
    items:
      - const: mca
      - const: mclk

  interrupts:
    maxItems: 1

  power-domains:
    maxItems: 1

  dmas:
    minItems: 1
    items:
      - description: SmartIO transmit (playback) endpoint
      - description: SmartIO receive (capture) endpoint

  dma-names:
    minItems: 1
    items:
      - const: tx
      - const: rx

  '#sound-dai-cells':
    const: 0

  '#clock-cells':
    const: 0

  clock-output-names:
    maxItems: 1

  apple,i2s-switch:
    $ref: /schemas/types.yaml#/definitions/phandle-array
    items:
      - items:
          - description: phandle of the i2s-switch syscon
          - description: index of this MCA's node in the switch (audN)
            maximum: 4
          - description: index of the pad the codec is wired to (pinN)
            maximum: 4
    description:
      The i2s-switch route between this MCA and the pad its codec is
      connected to. The route is programmed while a stream is prepared.

required:
  - compatible
  - reg
  - reg-names
  - interrupts
  - power-domains
  - dmas
  - dma-names
  - '#sound-dai-cells'
  - '#clock-cells'

unevaluatedProperties: false

examples:
  - |
    #include <dt-bindings/interrupt-controller/apple-aic.h>
    #include <dt-bindings/interrupt-controller/irq.h>

    soc {
      #address-cells = <2>;
      #size-cells = <2>;

      i2s_switch: syscon@20a003000 {
        compatible = "apple,s8000-i2s-switch", "syscon";
        reg = <0x2 0x0a003000 0x0 0x1000>;
      };

      mca@20a0a0000 {
        compatible = "apple,s8000-mca";
        reg = <0x2 0x0a0a0000 0x0 0x4000>,
              <0x2 0x0a002000 0x0 0x4>;
        reg-names = "mca", "mclk";
        interrupt-parent = <&aic>;
        interrupts = <AIC_IRQ 201 IRQ_TYPE_LEVEL_HIGH>;
        power-domains = <&ps_mca0>;
        dmas = <&sio 0x28>, <&sio 0x29>;
        dma-names = "tx", "rx";
        apple,i2s-switch = <&i2s_switch 0 0>;
        #clock-cells = <0>;
        clock-output-names = "mca0-mclk";
        #sound-dai-cells = <0>;
      };
    };
```

## Documentation/devicetree/bindings/sound/apple,t8010-pdm.yaml
```yaml
# SPDX-License-Identifier: (GPL-2.0-only OR BSD-2-Clause)
%YAML 1.2
---
$id: http://devicetree.org/schemas/sound/apple,t8010-pdm.yaml#
$schema: http://devicetree.org/meta-schemas/core.yaml#

title: Apple J71b T8010 PDM microphone controller

maintainers:
  - Henrik Klee <henrik@goat-code.com>

description: |
  The T8010 PDM controller receives two microphones through separate HP
  decimators. On J71b, the driver reads calibration from the live Apple
  device tree exposed by the existing bootloader as an ADT RAM MTD.
  Only the intersection of controller destination rates and both microphone
  coefficient providers is accepted. Calibration is validated against the
  actual MMIO resources and copied before the temporary ADT snapshot is freed.
  No calibration blobs or inferred clock frequencies belong in static DTS.
  The AOP service manages host high-power PDM requests. Board enablement must
  establish exclusive host request ownership; independent low-power firmware
  activity may remain after the host releases its request.

allOf:
  - $ref: dai-common.yaml#

properties:
  compatible:
    const: apple,j71b-pdm
  reg:
    items:
      - description: PDM controller registers
      - description: Decimator 0 registers and coefficient RAM
      - description: Decimator 1 registers and coefficient RAM
  reg-names:
    items:
      - const: pdmc
      - const: decimator0
      - const: decimator1
  interrupts:
    maxItems: 1
  apple,aop-audio:
    $ref: /schemas/types.yaml#/definitions/phandle
    description: AOP audio service controlling this PDM clock.
  power-domains:
    maxItems: 1
    description: AP PDM and high-frequency decimator domain (HFD0 on T8010).
  dmas:
    maxItems: 1
  dma-names:
    const: rx
  '#sound-dai-cells':
    const: 0

required:
  - compatible
  - reg
  - reg-names
  - interrupts
  - apple,aop-audio
  - power-domains
  - dmas
  - dma-names
  - '#sound-dai-cells'

unevaluatedProperties: false
```
