## Documentation/devicetree/bindings/input/touchscreen/apple,z2-multitouch.yaml
```yaml
# SPDX-License-Identifier: (GPL-2.0 OR BSD-2-Clause)
%YAML 1.2
---
$id: http://devicetree.org/schemas/input/touchscreen/apple,z2-multitouch.yaml#
$schema: http://devicetree.org/meta-schemas/core.yaml#

title: Apple touchscreens attached using the Z2 protocol

maintainers:
  - Sasha Finkelstein <k@chaosmail.tech>
  - Paul Praschl <praschlpaul@g-p.at>

description: A series of touchscreen controllers used in Apple products

properties:
  compatible:
    enum:
      - apple,j293-touchbar
      - apple,j493-touchbar
      - apple,j71b-touchscreen
      - apple,j71t-touchscreen
      - apple,j172-touchscreen
      - apple,d11-touchscreen
      - apple,d111-touchscreen
      - apple,n61-touchscreen

  interrupts:
    maxItems: 1

  reset-gpios:
    maxItems: 1

  power-ana-gpios:
    maxItems: 1

  power-ldo-gpios:
    maxItems: 1

  ana-supply:
    description:
      Analog supply for the touchscreen controller, where a PMIC switch
      rather than a GPIO provides it

  hv-supply:
    description: High-voltage analog supply for the touchscreen controller

  core-supply:
    description: Core supply for the touchscreen controller

  display-sync-gpios:
    maxItems: 1

  display-sync1-gpios:
    maxItems: 1

  spi-cpha: true

  spi-cpol: true

  clocks:
    maxItems: 1

  ana-supply:
    description: N61 analog touchscreen supply from the Chestnut high-voltage switch

  apple,z2-prox-cal-blob:
    $ref: /schemas/types.yaml#/definitions/uint8-array
    maxItems: 128
    description: Optional N61 proximity calibration supplied by the bootloader

  apple,z2-bpw16-min-len:
    $ref: /schemas/types.yaml#/definitions/uint32
    description:
      Minimum firmware blob length sent using 16 bits per word.
    default: 1

  apple,z2-no-init-ack:
    description:
      Do not append the standard 0x1a 0xa1 ACK transfer after the initial
      firmware payload.
    type: boolean

  firmware-name:
    maxItems: 1

  apple,z2-cal-blob:
    $ref: /schemas/types.yaml#/definitions/uint8-array
    maxItems: 4096
    description:
      Calibration blob supplied by the bootloader. N61 requires this
      per-unit data at driver probe; it can be absent from a static DTB
      before the bootloader adds it.

  apple,z2-orb-gap-cal-blob:
    $ref: /schemas/types.yaml#/definitions/uint8-array
    maxItems: 4096
    description:
      Orb gap calibration blob supplied by the bootloader

  apple,z2-orb-force-cal-blob:
    $ref: /schemas/types.yaml#/definitions/uint8-array
    maxItems: 4096
    description:
      Orb force calibration blob supplied by the bootloader

  apple,z2-shape-accel-cal-blob:
    $ref: /schemas/types.yaml#/definitions/uint8-array
    maxItems: 4096
    description:
      Dynamic shape acceleration calibration blob supplied by the bootloader

  apple,z2-display-offset-cal-blob:
    $ref: /schemas/types.yaml#/definitions/uint8-array
    maxItems: 4096
    description:
      Touch-to-display offset calibration blob supplied by the bootloader

  apple,z2-firefly-cal-blob:
    $ref: /schemas/types.yaml#/definitions/uint8-array
    maxItems: 262144
    description:
      Firefly calibration blob supplied by the bootloader

  apple,z2-pressure-cal-blob:
    $ref: /schemas/types.yaml#/definitions/uint8-array
    maxItems: 262144
    description:
      Pressure effect correction blob supplied by the bootloader

  apple,z2-firefly-p100-cal-blob:
    $ref: /schemas/types.yaml#/definitions/uint8-array
    maxItems: 262144
    description:
      Firefly P100 calibration blob supplied by the bootloader

  apple,z2-ext-cal-blob:
    $ref: /schemas/types.yaml#/definitions/uint8-array
    maxItems: 262144
    description:
      Extended multi-touch calibration blob supplied by the bootloader

required:
  - compatible
  - interrupts
  - reset-gpios
  - firmware-name
  - touchscreen-size-x
  - touchscreen-size-y

allOf:
  - $ref: touchscreen.yaml#
  - $ref: /schemas/spi/spi-peripheral-props.yaml#
  - if:
      properties:
        compatible:
          const: apple,j172-touchscreen
    then:
      properties:
        pinctrl-names:
          const: display-sync-active
      required:
        - clocks
        - power-ana-gpios
        - power-ldo-gpios
        - display-sync-gpios
        - display-sync1-gpios
        - pinctrl-0
        - pinctrl-names
        - spi-cpha
        - spi-cpol
        - apple,z2-bpw16-min-len
        - apple,z2-no-init-ack
  - if:
      properties:
        compatible:
          const: apple,j71t-touchscreen
    then:
      properties:
        pinctrl-names:
          items:
            - const: display-sync-active
            - const: display-sync-inactive
        power-ana-gpios: false
        display-sync-gpios: false
        display-sync1-gpios: false
        hv-supply: false
        core-supply: false
        spi-cpha: false
        spi-cpol: false
        apple,z2-bpw16-min-len: false
        apple,z2-no-init-ack: false
      required:
        - clocks
        - ana-supply
        - power-ldo-gpios
        - pinctrl-0
        - pinctrl-1
        - pinctrl-names
    else:
      properties:
        ana-supply: false
  - if:
      properties:
        compatible:
          const: apple,j71b-touchscreen
    then:
      properties:
        display-sync-gpios: false
        display-sync1-gpios: false
      required:
        - clocks
        - power-ana-gpios
        - power-ldo-gpios
        - spi-cpha
        - spi-cpol
        - apple,z2-bpw16-min-len
        - apple,z2-no-init-ack
  - if:
      properties:
        compatible:
          enum:
            - apple,d11-touchscreen
            - apple,d111-touchscreen
    then:
      required:
        - clocks
        - hv-supply
        - core-supply
        - spi-cpha
        - spi-cpol
        - apple,z2-no-init-ack

  - if:
      properties:
        compatible:
          const: apple,n61-touchscreen
    then:
      properties:
        apple,z2-cal-blob:
          minItems: 1
          maxItems: 1024
        power-ana-gpios: false
        power-ldo-gpios: false
        display-sync-gpios: false
        display-sync1-gpios: false
        spi-cpha: false
        spi-cpol: false
      required:
        - ana-supply
        - core-supply
        - clocks

unevaluatedProperties: false

examples:
  - |
    #include <dt-bindings/gpio/gpio.h>
    #include <dt-bindings/interrupt-controller/irq.h>

    spi {
        #address-cells = <1>;
        #size-cells = <0>;

        touchscreen@0 {
            compatible = "apple,j293-touchbar";
            reg = <0>;
            spi-max-frequency = <11500000>;
            reset-gpios = <&pinctrl_ap 139 GPIO_ACTIVE_LOW>;
            interrupts-extended = <&pinctrl_ap 194 IRQ_TYPE_EDGE_FALLING>;
            firmware-name = "apple/dfrmtfw-j293.bin";
            touchscreen-size-x = <23045>;
            touchscreen-size-y = <640>;
        };
    };

  - |
    #include <dt-bindings/gpio/gpio.h>
    #include <dt-bindings/interrupt-controller/irq.h>

    spi {
        #address-cells = <1>;
        #size-cells = <0>;

        touchscreen@0 {
            compatible = "apple,j71t-touchscreen";
            reg = <0>;
            spi-max-frequency = <12048192>;
            interrupts-extended = <&pinctrl_ap 65 IRQ_TYPE_EDGE_FALLING>;
            reset-gpios = <&pinctrl_ap 75 GPIO_ACTIVE_LOW>;
            power-ldo-gpios = <&pinctrl_ap 73 GPIO_ACTIVE_HIGH>;
            ana-supply = <&touch_analog>;
            clocks = <&touchclk>;
            pinctrl-names = "display-sync-active", "display-sync-inactive";
            pinctrl-0 = <&touch_display_sync_active>;
            pinctrl-1 = <&touch_display_sync_inactive>;
            firmware-name = "apple/j71t-fwstart.z2fw";
            touchscreen-size-x = <1536>;
            touchscreen-size-y = <2048>;
            touchscreen-inverted-y;
        };
    };

...
```

## Documentation/devicetree/bindings/iommu/apple,dart.yaml
```yaml
# SPDX-License-Identifier: (GPL-2.0 OR BSD-2-Clause)
%YAML 1.2
---
$id: http://devicetree.org/schemas/iommu/apple,dart.yaml#
$schema: http://devicetree.org/meta-schemas/core.yaml#

title: Apple DART IOMMU

maintainers:
  - Sven Peter <sven@svenpeter.dev>

description: |+
  Apple SoCs may contain an implementation of their Device Address
  Resolution Table which provides a mandatory layer of address
  translations for various masters.

  Each DART instance is capable of handling up to 16 different streams
  with individual pagetables and page-level read/write protection flags.

  This DART IOMMU also raises interrupts in response to various
  fault conditions.

properties:
  compatible:
    oneOf:
      - enum:
          - apple,s5l8960x-dart
          - apple,t8103-dart
          - apple,t8103-usb4-dart
          - apple,t8110-dart
          - apple,t6000-dart
      - items:
          - const: apple,t6020-dart
          - const: apple,t8110-dart
      - items:
          - enum:
              - apple,t7000-dart
              - apple,s8000-dart
              - apple,t8010-dart
          - const: apple,s5l8960x-dart

  reg:
    maxItems: 1

  interrupts:
    maxItems: 1

  clocks:
    description:
      Reference to the gate clock phandle if required for this IOMMU.
      Optional since not all IOMMUs are attached to a clock gate.

  '#iommu-cells':
    enum: [ 1, 5 ]
    description:
      Has to be one or five. The first cell describes the stream id emitted by
      a master to the IOMMU. The optional second and third cell describe the
      aperture start of a master's DMA window and fourth and fifth cell describe
      the size of DMA window.

  power-domains:
    maxItems: 1

  apple,error-reflector:
    $ref: /schemas/types.yaml#/definitions/uint64
    description:
      Physical address of the page that faulting transactions are redirected
      to, so that they complete instead of stalling the master. From the
      Apple device tree property "error-reflector" of the same DART.

  apple,fetch-config:
    $ref: /schemas/types.yaml#/definitions/uint32
    description:
      Value of the table fetch configuration register, from the Apple device
      tree property "fetch-config" of the same DART.

  apple,diag-config:
    $ref: /schemas/types.yaml#/definitions/uint32
    description:
      Value of the diagnostic configuration register, from the Apple device
      tree property "diag-config" of the same DART.

required:
  - compatible
  - reg
  - '#iommu-cells'
  - interrupts

allOf:
  - if:
      properties:
        compatible:
          not:
            contains:
              const: apple,s5l8960x-dart
    then:
      properties:
        apple,error-reflector: false
        apple,fetch-config: false
        apple,diag-config: false

additionalProperties: false

examples:
  - |+
    dart1: iommu@82f80000 {
      compatible = "apple,t8103-dart";
      reg = <0x82f80000 0x4000>;
      interrupts = <1 781 4>;
      #iommu-cells = <5>;
    };

    master1 {
      iommus = <&dart1 0 0x100 0x0 0x10 0x0>;
    };

  - |+
    dart2a: iommu@82f00000 {
      compatible = "apple,t8103-dart";
      reg = <0x82f00000 0x4000>;
      interrupts = <1 781 4>;
      #iommu-cells = <1>;
    };
    dart2b: iommu@82f80000 {
      compatible = "apple,t8103-dart";
      reg = <0x82f80000 0x4000>;
      interrupts = <1 781 4>;
      #iommu-cells = <1>;
    };

    master2 {
      iommus = <&dart2a 0>, <&dart2b 1>;
    };

  - |+
    dart3: iommu@1008000 {
      compatible = "apple,s8000-dart", "apple,s5l8960x-dart";
      reg = <0x1008000 0x4000>;
      interrupts = <1 245 4>;
      #iommu-cells = <5>;
      apple,error-reflector = /bits/ 64 <0x20fffc000>;
      apple,fetch-config = <0x000e0303>;
      apple,diag-config = <0x00000100>;
    };
```

## Documentation/devicetree/bindings/media/apple,s8000-vxd.yaml
```yaml
# SPDX-License-Identifier: (GPL-2.0-only OR BSD-2-Clause)
%YAML 1.2
---
$id: http://devicetree.org/schemas/media/apple,s8000-vxd.yaml#
$schema: http://devicetree.org/meta-schemas/core.yaml#

title: Apple VXD video decoder (Imagination PowerVR MSVDX)

maintainers:
  - Berkay Kösebay <brkosebay@users.noreply.github.com>

description:
  The Apple "VXD" block is a multi-standard hardware video decoder, an
  Imagination PowerVR MSVDX core whose MTX (META) microcontroller runs the
  DEVA firmware. Apple has used this IP family since the S5L8940X (A4); the
  S8000/S8003 (A9) reports vxd-version 7 in the Apple device tree. The block
  has no DART; it translates its own memory accesses through a two-level
  "GART" that the host programs through the MTX MMU registers.

properties:
  compatible:
    const: apple,s8000-vxd

  reg:
    maxItems: 1

  interrupts:
    maxItems: 1

  power-domains:
    maxItems: 1

required:
  - compatible
  - reg
  - interrupts
  - power-domains

additionalProperties: false

examples:
  - |
    #include <dt-bindings/interrupt-controller/apple-aic.h>
    #include <dt-bindings/interrupt-controller/irq.h>

    soc {
        #address-cells = <2>;
        #size-cells = <2>;

        video-codec@207f00000 {
            compatible = "apple,s8000-vxd";
            reg = <0x2 0x07f00000 0x0 0x100000>;
            interrupt-parent = <&aic>;
            interrupts = <AIC_IRQ 157 IRQ_TYPE_LEVEL_HIGH>;
            power-domains = <&ps_vdec>;
        };
    };
```
