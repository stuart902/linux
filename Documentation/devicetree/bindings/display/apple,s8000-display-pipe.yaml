## Documentation/devicetree/bindings/display/apple,s8000-display-pipe.yaml
```yaml
# SPDX-License-Identifier: (GPL-2.0-only OR BSD-2-Clause)
%YAML 1.2
---
$id: http://devicetree.org/schemas/display/apple,s8000-display-pipe.yaml#
$schema: http://devicetree.org/meta-schemas/core.yaml#

title: Apple A9 display pipe (disp0)

maintainers:
  - Berkay Kösebay <brkosebay@users.noreply.github.com>

description: |
  The display subsystem of the Apple A9 SoCs (S8000/S8003), called "disp0"
  with the compatible "adbe0,s8000" in the Apple device tree. It contains
  the ADP/ADBE display pipe that scans out to the internal eDP panel. The
  bootloader leaves the pipe, the eDP link and the panel running; the pipe
  reads memory through the display DART (dart-disp0), which the bootloader
  leaves in bypass. The DART has no node of its own: it must not be reset
  under the running scanout, so its two register windows are listed here
  and only read, to check that the scanout bypasses translation.

properties:
  compatible:
    const: apple,s8000-display-pipe

  reg:
    minItems: 6
    items:
      - description:
          ADP window, with the control and interrupt registers, the
          parameter FIFO port and the pipe layer registers
      - description: Display block window A
      - description: Display block window B
      - description: Display block window C
      - description: Display block window D
      - description: Seven-register side block
      - description: Display DART (dart-disp0), first window
      - description: Display DART (dart-disp0), second window

  reg-names:
    minItems: 6
    items:
      - const: adp
      - const: disp-a
      - const: disp-b
      - const: disp-c
      - const: disp-d
      - const: side
      - const: dart0
      - const: dart1

  interrupts:
    items:
      - description:
          Pipe interrupt; carries vblank, parameter packet completion
          and pipe errors
      - description: Back-end interrupt
      - description: Third display interrupt
      - description: Fourth display interrupt
      - description: Fifth display interrupt

  power-domains:
    items:
      - description: Display pipe (disp0)
      - description: DisplayPort/eDP controller (dp)

required:
  - compatible
  - reg
  - interrupts
  - power-domains

additionalProperties: false

examples:
  - |
    #include <dt-bindings/interrupt-controller/apple-aic.h>
    #include <dt-bindings/interrupt-controller/irq.h>

    soc {
        #address-cells = <2>;
        #size-cells = <2>;

        display-controller@206200000 {
            compatible = "apple,s8000-display-pipe";
            reg = <0x2 0x06200000 0x0 0x100000>,
                  <0x2 0x06400000 0x0 0x8000>,
                  <0x2 0x06440000 0x0 0x8000>,
                  <0x2 0x06480000 0x0 0x8000>,
                  <0x2 0x064c0000 0x0 0x8000>,
                  <0x2 0x06500000 0x0 0x1c>,
                  <0x2 0x06304000 0x0 0x4000>,
                  <0x2 0x06300000 0x0 0x4000>;
            reg-names = "adp", "disp-a", "disp-b", "disp-c", "disp-d",
                        "side", "dart0", "dart1";
            interrupt-parent = <&aic>;
            interrupts = <AIC_IRQ 140 IRQ_TYPE_LEVEL_HIGH>,
                         <AIC_IRQ 143 IRQ_TYPE_LEVEL_HIGH>,
                         <AIC_IRQ 144 IRQ_TYPE_LEVEL_HIGH>,
                         <AIC_IRQ 145 IRQ_TYPE_LEVEL_HIGH>,
                         <AIC_IRQ 146 IRQ_TYPE_LEVEL_HIGH>;
            power-domains = <&ps_disp0>, <&ps_dp>;
        };
    };
```

## Documentation/devicetree/bindings/gpio/apple,d2365-pmic-gpio.yaml
```yaml
# SPDX-License-Identifier: (GPL-2.0-only OR BSD-2-Clause)
%YAML 1.2
---
$id: http://devicetree.org/schemas/gpio/apple,d2365-pmic-gpio.yaml#
$schema: http://devicetree.org/meta-schemas/core.yaml#

title: Apple A8/A9/A10 PMIC GPIO and event interrupt controller

maintainers:
  - Paul Praschl <praschlpaul@g-p.at>

description: |
  The Dialog D2207 PMIC used with the Apple A8X and the D2333 and D2365
  PMICs used in Apple A9 and A10 devices provide 21, 21 and 24 GPIOs
  respectively. The controller is accessed through the regmap exported by the
  parent Apple I2C PMIC device.

  The D2207 and D2365 also latch 112 and 240 PMU events respectively
  (charger, ADC, GPIO edges and others) in one read-to-clear block and
  signal them on a single active-low line to the AP. As an interrupt
  controller the node owns that block: the interrupt specifier is the PMU
  event number and a flags cell. PMIC GPIO line N is event 0x18 + N on the
  D2207 and 0x30 + N on the D2365, so GPIO consumers get their interrupt
  through the GPIO specifier as well. Events are latched; what triggers a
  GPIO event is the line configuration left by the boot firmware, so only
  edge flags are accepted.

  Interrupt 112 (D2207) or 240 (D2365), one past the last event, is the
  event line itself. Its consumers run on every assertion of the line,
  before the event block is read, so that a consumer can act before the I2C
  read that tells which event it was (the Lightning charger withdraws its
  input-current grant there).

properties:
  compatible:
    enum:
      - apple,d2207-pmic-gpio
      - apple,d2333-pmic-gpio
      - apple,d2365-pmic-gpio

  gpio-controller: true

  "#gpio-cells":
    const: 2

  gpio-reserved-ranges:
    maxItems: 3

  interrupt-controller: true

  "#interrupt-cells":
    const: 2

  interrupts:
    maxItems: 1
    description: PMU event output of the PMIC, active low.

  apple,wake-events:
    $ref: /schemas/types.yaml#/definitions/uint32-array
    minItems: 1
    maxItems: 24
    items:
      minimum: 0x18
      maximum: 0x47
    description: |
      GPIO events (the first GPIO event plus the line number) that end system
      sleep and have no interrupt consumer, such as the iPad Smart Cover hall
      sensors on D2365 lines 0 and 10 (events 0x30 and 0x3a) or D2207 lines
      10 and 12 (events 0x22 and 0x24). They stay masked while the
      system is awake, where the line is read through the GPIO instead, and
      are unmasked only while it sleeps: a hall sensor drives the PMU line on
      every change of the magnet field. They cannot be mapped as interrupts.

required:
  - compatible
  - gpio-controller
  - "#gpio-cells"

dependencies:
  interrupt-controller: ["#interrupt-cells"]
  apple,wake-events: [interrupt-controller]

allOf:
  - if:
      properties:
        compatible:
          const: apple,d2333-pmic-gpio
    then:
      properties:
        interrupt-controller: false
        "#interrupt-cells": false
        interrupts: false
        apple,wake-events: false
  - if:
      properties:
        compatible:
          const: apple,d2207-pmic-gpio
    then:
      properties:
        apple,wake-events:
          maxItems: 21
          items:
            maximum: 0x2c
  - if:
      properties:
        compatible:
          const: apple,d2365-pmic-gpio
    then:
      properties:
        apple,wake-events:
          items:
            minimum: 0x30

additionalProperties: false

examples:
  - |
    #include <dt-bindings/interrupt-controller/irq.h>

    pmic {
        #address-cells = <1>;
        #size-cells = <1>;

        gpio {
            compatible = "apple,d2365-pmic-gpio";
            #gpio-cells = <2>;
            gpio-controller;
            #interrupt-cells = <2>;
            interrupt-controller;
            interrupts = <38 IRQ_TYPE_LEVEL_LOW>;
            apple,wake-events = <0x30 0x3a>;
        };
    };
...
```

## Documentation/devicetree/bindings/iio/light/tsl2583.yaml
```yaml
# SPDX-License-Identifier: (GPL-2.0 OR BSD-2-Clause)
%YAML 1.2
---
$id: http://devicetree.org/schemas/iio/light/tsl2583.yaml#
$schema: http://devicetree.org/meta-schemas/core.yaml#

title: AMS/TAOS Ambient Light Sensor (ALS)

maintainers:
  - Brian Masney <masneyb@onstation.org>

description: |
  Ambient light sensing with an i2c interface. The Apple CT819 and CT821
  factory calibration is stored in SysCfg. Boot firmware either copies the
  resolved record into apple,als-calibration or, where it creates the SysCfg
  NVMEM provider, adds both NVMEM properties before kernel handoff. The
  static board tree carries neither.

properties:
  compatible:
    oneOf:
      - enum:
          - amstaos,tsl2580
          - amstaos,tsl2581
          - amstaos,tsl2583
      - items:
          - enum:
              - apple,ct819
              - apple,ct821
          - const: amstaos,tsl2581

  reg:
    maxItems: 1

  interrupts:
    maxItems: 1

  vcc-supply:
    description: Regulator that provides power to the sensor

  apple,als-calibration:
    $ref: /schemas/types.yaml#/definitions/uint8-array
    minItems: 8
    maxItems: 1024
    description:
      Apple factory LSCI ambient-light calibration record, the raw bytes of
      the ADT alsCalibration property as resolved by iBoot. Used instead of
      nvmem-cells when present.

  nvmem-cells:
    description:
      Apple factory LSCI ambient-light calibration data. Boot firmware must
      populate this together with nvmem-cell-names when the provider is not
      statically representable.
    maxItems: 1

  nvmem-cell-names:
    items:
      - const: calibration

required:
  - compatible
  - reg

allOf:
  - if:
      properties:
        compatible:
          contains:
            enum:
              - apple,ct819
              - apple,ct821
    then:
      dependentRequired:
        nvmem-cells:
          - nvmem-cell-names
        nvmem-cell-names:
          - nvmem-cells
    else:
      properties:
        apple,als-calibration: false
        nvmem-cells: false
        nvmem-cell-names: false

additionalProperties: false

examples:
  - |
    i2c {
        #address-cells = <1>;
        #size-cells = <0>;

        light-sensor@29 {
            compatible = "apple,ct821", "amstaos,tsl2581";
            reg = <0x29>;
            nvmem-cells = <&als_calibration>;
            nvmem-cell-names = "calibration";
        };
    };
  - |
    i2c {
        #address-cells = <1>;
        #size-cells = <0>;

        light-sensor@39 {
            compatible = "apple,ct819", "amstaos,tsl2581";
            reg = <0x39>;
            /* Copied by the bootloader from the ADT; header only here */
            apple,als-calibration = [00 02 01 08 48 00 a2 f8];
        };
    };
...
```
