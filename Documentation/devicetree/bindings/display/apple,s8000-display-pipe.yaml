## Documentation/devicetree/bindings/sound/cirrus,cs42l81.yaml
```yaml
# SPDX-License-Identifier: (GPL-2.0-only OR BSD-2-Clause)
%YAML 1.2
---
$id: http://devicetree.org/schemas/sound/cirrus,cs42l81.yaml#
$schema: http://devicetree.org/meta-schemas/core.yaml#

title: Cirrus Logic CS42L81 audio codec

maintainers:
  - Berkay Kösebay <brkosebay@users.noreply.github.com>

description: |
  Apple-specific Cirrus Logic codec with integrated speaker drivers, a
  headphone driver and digital microphone inputs, used in the A9 iPad 5.
  It is controlled over SPI with a 5-byte paged register protocol.

  Codec pins for the machine's routing: outputs SPKOUT and HPOUT, digital
  microphone inputs DMIC1A and DMIC1B.

allOf:
  - $ref: dai-common.yaml#
  - $ref: /schemas/spi/spi-peripheral-props.yaml#

properties:
  compatible:
    const: cirrus,cs42l81

  reg:
    maxItems: 1

  clocks:
    maxItems: 1

  clock-names:
    const: mclk

  mute-gpios:
    maxItems: 1
    description: Speaker mute line, asserted while the speakers are muted.

  cirrus,speaker-max-gain:
    $ref: /schemas/types.yaml#/definitions/int32
    minimum: -10200
    maximum: 1200
    description:
      Maximum speaker gain the volume control allows, in 0.01 dB units.
      Without it, the control goes up to +12 dB.

  '#sound-dai-cells':
    const: 0

required:
  - compatible
  - reg
  - clocks
  - clock-names
  - '#sound-dai-cells'

unevaluatedProperties: false

examples:
  - |
    #include <dt-bindings/gpio/gpio.h>

    spi {
      #address-cells = <1>;
      #size-cells = <0>;

      audio-codec@0 {
        compatible = "cirrus,cs42l81";
        reg = <0>;
        spi-max-frequency = <1000000>;
        clocks = <&mca0>;
        clock-names = "mclk";
        mute-gpios = <&pinctrl_ap 64 GPIO_ACTIVE_LOW>;
        cirrus,speaker-max-gain = <(-300)>;
        #sound-dai-cells = <0>;
      };
    };
```

## Documentation/devicetree/bindings/thermal/apple,s8003-thermal.yaml
```yaml
# SPDX-License-Identifier: (GPL-2.0-only OR BSD-2-Clause)
%YAML 1.2
---
$id: http://devicetree.org/schemas/thermal/apple,s8003-thermal.yaml#
$schema: http://devicetree.org/meta-schemas/core.yaml#

title: Apple S8003 on-die temperature sensors

maintainers:
  - Berkay Kösebay <brkosebay@users.noreply.github.com>

description: |
  The Apple A9 (S8003) has three temperature sensors in the power manager
  (SOC0 to SOC2) and three in the CPU complex (TCC0 to TCC2), called
  "tempsensor,s8000" in the Apple device tree. The hardware converts with
  the calibration the boot chain programs.

  The sensor specifier is the channel: 0 to 2 select SOC0 to SOC2, 3 to 5
  select TCC0 to TCC2.

allOf:
  - $ref: thermal-sensor.yaml#

properties:
  compatible:
    const: apple,s8003-thermal

  reg:
    items:
      - description: SOC sensor registers
      - description: TCC sensor registers

  reg-names:
    items:
      - const: soc
      - const: tcc

  '#thermal-sensor-cells':
    const: 1

required:
  - compatible
  - reg
  - reg-names
  - '#thermal-sensor-cells'

unevaluatedProperties: false

examples:
  - |
    soc {
        #address-cells = <2>;
        #size-cells = <2>;

        thermal-sensor@20e0c0000 {
            compatible = "apple,s8003-thermal";
            reg = <0x2 0x0e0c0000 0x0 0x1000>,
                  <0x2 0x02230000 0x0 0x1000>;
            reg-names = "soc", "tcc";
            #thermal-sensor-cells = <1>;
        };
    };
```

## drivers/gpu/drm/adbe/Kconfig
```kconfig
# SPDX-License-Identifier: GPL-2.0-only
config DRM_APPLE_ADBE
	tristate "DRM support for the Apple A9 display pipe"
	depends on DRM && OF && ARM64 && MMU
	depends on ARCH_APPLE || COMPILE_TEST
	select APERTURE_HELPERS
	select DRM_CLIENT_SELECTION
	select DRM_GEM_DMA_HELPER
	select DRM_KMS_HELPER
	help
	  KMS driver for the display pipe (disp0) of the Apple A9 SoCs
	  (S8000/S8003), as used in the iPad 5. It adopts the mode the
	  bootloader leaves running, takes the framebuffer over from
	  simpledrm, and adds page flips and vblank interrupts. It never
	  programs timings, clocks or the eDP link.

	  If M is selected, the module is called apple_adbe_drm.
```

## drivers/gpu/drm/imagination/Kconfig
```kconfig
# SPDX-License-Identifier: GPL-2.0-only OR MIT
# Copyright (c) 2023 Imagination Technologies Ltd.

config DRM_POWERVR
	tristate "Imagination Technologies PowerVR (Series 6 and later) & IMG Graphics"
	depends on (ARM64 || RISCV && 64BIT)
	depends on DRM
	depends on MMU
	depends on PM
	depends on POWER_SEQUENCING || !POWER_SEQUENCING
	select DRM_EXEC
	select DRM_GEM_SHMEM_HELPER
	select DRM_SCHED
	select DRM_GPUVM
	select FW_LOADER
	help
	  Choose this option if you have a system that has an Imagination
	  Technologies PowerVR (Series 6 or later) or IMG GPU.

	  If "M" is selected, the module will be called powervr.

config DRM_POWERVR_APPLE
	bool "Apple A10 (T8010) GPU support"
	depends on DRM_POWERVR
	depends on APPLE_RTKIT && (ARCH_APPLE || COMPILE_TEST)
	depends on DRM_POWERVR=m || APPLE_RTKIT=y
	help
	  Support the Rogue-based GPU of the Apple A10 (T8010), which runs
	  Apple's GFX firmware on an RTKit coprocessor instead of
	  Imagination's firmware.

	  If in doubt, say "N".

config DRM_POWERVR_KUNIT_TEST
	tristate "KUnit tests for the drm powervr driver" if !KUNIT_ALL_TESTS
	depends on DRM_POWERVR && KUNIT
	default KUNIT_ALL_TESTS
	help
	  Choose this option to allow the driver to perform selftests under
	  the kunit framework

	  Recommended for driver developers only.

	  If in doubt, say "N".
```

## drivers/media/platform/apple/vxd/Kconfig
```kconfig
# SPDX-License-Identifier: GPL-2.0
config VIDEO_APPLE_VXD
	tristate "Apple VXD (PowerVR MSVDX) video decoder driver"
	depends on VIDEO_DEV
	depends on ARCH_APPLE || COMPILE_TEST
	select MEDIA_CONTROLLER
	select VIDEOBUF2_DMA_CONTIG
	select V4L2_MEM2MEM_DEV
	select V4L2_H264
	select CRC32
	help
	  Support for the Apple "VXD" video decoder of the S8000/S8003 (A9)
	  SoCs: an Imagination PowerVR MSVDX core driven by the DEVA (MTX)
	  firmware. It is exposed as a V4L2 stateless H.264 decoder, and as
	  an HEVC (H.265 Main) decoder on the SoCs whose decoder has it.

	  The driver needs the DEVA firmware as apple/vxd-deva.bin.

	  To compile this driver as a module, choose M here: the module
	  will be called apple-vxd.
```

## sound/soc/apple/Kconfig
```kconfig
# SPDX-License-Identifier: GPL-2.0-only
menu "Apple"

config SND_SOC_APPLE_MCA
	tristate "Apple Silicon MCA driver"
	depends on ARCH_APPLE || COMPILE_TEST
	select SND_DMAENGINE_PCM
	help
	  This option enables an ASoC platform driver for MCA peripherals found
	  on Apple Silicon SoCs.

config SND_SOC_APPLE_S8000_MCA
	tristate "Apple S8000/T8010 MCA driver"
	depends on ARCH_APPLE || COMPILE_TEST
	depends on COMMON_CLK
	select MFD_SYSCON
	select SND_SOC_GENERIC_DMAENGINE_PCM
	help
	  This option enables an ASoC CPU DAI driver for the "mca-version 4"
	  I2S serializer of the Apple A9 (S8000/S8003), and the version 5
	  serializer of the A10 (T8010). The driver also
	  exports the MCA's MCLK output as a clock for the codec and routes
	  the MCA to its pad in the shared i2s-switch. Samples are moved by
	  SmartIO DMA, so APPLE_SIO_DMA is needed for audio.

	  Say Y or M here if you have an Apple A9 device such as the iPad 5 or iPad 6.

config SND_SOC_APPLE_T8010_PDM
	tristate "Apple T8010 PDM capture (experimental)"
	depends on ARCH_APPLE || COMPILE_TEST
	depends on OF && DMA_ENGINE && EXPERT
	depends on APPLE_AOP_AUDIO && APPLE_SIO_DMA
	help
	  Build the experimental T8010 microphone consumer for development.
	  This is not microphone enablement: no board node or sound card is
	  supplied. A firmware-owned PDM clock and live calibration are needed.
	  Requires ownership-preserving SmartIO drain and exclusive AOP clock
	  ownership. Faulted teardown may wait until a device reset.
	  Do not enable a board node until these contracts are verified.
	  If unsure, say N.

config SND_SOC_APPLE_T8010_PDM_KUNIT_TEST
	tristate "T8010 PDM calibration arithmetic tests" if !KUNIT_ALL_TESTS
	depends on KUNIT
	default KUNIT_ALL_TESTS
	help
	  Test calibration bounds, register packing and capture discard sizing
	  using synthetic inputs. The tests do not access hardware or enable
	  the microphone driver. No firmware or factory calibration is used.
	  These tests do not establish safe DMA lifetime or audio quality.

endmenu
```
