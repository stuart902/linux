## Documentation/devicetree/bindings/pci/apple,t8010-pcie.yaml
```yaml
# SPDX-License-Identifier: (GPL-2.0-only OR BSD-2-Clause)
%YAML 1.2
---
$id: http://devicetree.org/schemas/pci/apple,t8010-pcie.yaml#
$schema: http://devicetree.org/meta-schemas/core.yaml#

title: Apple T7000 and T8010 PCIe host controller

maintainers:
  - Paul Praschl <praschlpaul@g-p.at>

description: |
  Apple A10/T8010 devices use the H9P PCIe root complex for internal
  storage and Wi-Fi. It exposes one ECAM window shared by up to four root
  ports, controller-specific PHY and port register windows, and a local MSI
  block.

  The storage port also contains an NVMMU which translates the proprietary
  Apple ANS FlatDMA format. Unlike a general-purpose IOMMU, this block uses a
  loader-provided, physically contiguous host-memory buffer and a fixed IOVA
  window. The PCIe driver owns that NVMMU state and exposes it only to the ANS
  NVMe glue.

  Apple A8/A8X (T7000/T7001) devices use an earlier version of the same root
  complex, with the same ECAM layout, port register block and MSI block. It
  has no separate PHY register windows and no NVMMU, and its reference and
  auxiliary clocks are power domains.

  Each enabled root port is represented by a child node. This allows port
  devices to carry their own reset, clock-request, firmware and other
  device-specific properties.

allOf:
  - $ref: /schemas/pci/pci-host-bridge.yaml#
  - $ref: /schemas/interrupt-controller/msi-controller.yaml#
  - if:
      properties:
        compatible:
          contains:
            const: apple,t7000-pcie
    then:
      properties:
        reg:
          maxItems: 6
        reg-names:
          items:
            - const: config
            - const: rc
            - const: port0
            - const: port1
            - const: port2
            - const: port3
        interrupts:
          maxItems: 4
        interrupt-names:
          maxItems: 4
        power-domains:
          items:
            - description: PCIe controller
            - description: PCIe reference clock
            - description: PCIe auxiliary clock
        clocks: false
        clock-names: false
        apple,nvmmu-iova: false
        apple,nvme-hmb: false
        apple,preinit-phy-port-mask: false
    else:
      properties:
        reg:
          minItems: 9
        reg-names:
          items:
            - const: config
            - const: rc
            - const: phy
            - const: phy-ip
            - const: port0
            - const: port1
            - const: port2
            - const: port3
            - const: nvmmu
        interrupts:
          minItems: 5
        interrupt-names:
          minItems: 5
        power-domains:
          maxItems: 1
      required:
        - clocks
        - clock-names
        - apple,nvmmu-iova
        - apple,nvme-hmb

properties:
  compatible:
    oneOf:
      - enum:
          - apple,t7000-pcie
          - apple,t8010-pcie
      - items:
          - const: apple,j172-pcie
          - const: apple,t8010-pcie

  reg:
    minItems: 6
    maxItems: 9

  reg-names:
    minItems: 6
    maxItems: 9

  interrupts:
    description:
      One state interrupt for each root port followed, on T8010, by the
      storage-port NVMMU fault interrupt.
    minItems: 4
    maxItems: 5

  interrupt-names:
    minItems: 4
    items:
      - const: port0
      - const: port1
      - const: port2
      - const: port3
      - const: nvmmu

  clocks:
    minItems: 2
    maxItems: 2

  clock-names:
    items:
      - const: aux
      - const: ref

  power-domains:
    minItems: 1
    maxItems: 3

  msi-parent: true

  msi-ranges:
    maxItems: 1

  apple,msi-doorbell:
    $ref: /schemas/types.yaml#/definitions/uint32
    description:
      MSI doorbell address programmed into downstream endpoints.

  apple,nvmmu-iova:
    $ref: /schemas/types.yaml#/definitions/uint32
    description:
      Base device-visible address of the storage-port NVMMU window.

  apple,nvme-hmb:
    $ref: /schemas/types.yaml#/definitions/phandle
    description:
      Phandle of the loader-populated reserved-memory node used as the Apple
      ANS NVMe host-memory buffer.

  apple,preinit-phy-port-mask:
    $ref: /schemas/types.yaml#/definitions/uint32
    maximum: 15
    description:
      Bit mask of internal root ports whose RC and PHY lane must be initialized
      without exposing a root bridge. This is used when an enabled port shares
      PHY state with a firmware-enabled sibling port.

  interrupt-controller: true

  '#interrupt-cells':
    const: 1

patternProperties:
  '^pci@[0-3],0$':
    type: object
    properties:
      reg:
        maxItems: 1

      reset-gpios:
        maxItems: 1

      clkreq-gpios:
        maxItems: 1
        description:
          Software-observable CLKREQ# input. This is optional when the pad is
          pinmuxed directly to the PCIe controller instead.

      max-link-speed:
        enum: [1, 2, 3]
        description:
          Maximum link generation exposed by this root port. This also limits
          the controller's Link Capabilities registers when runtime speed
          retraining is not implemented for the port.

      apple,phy-lane:
        $ref: /schemas/types.yaml#/definitions/uint32
        maximum: 3
        description:
          PHY IP calibration lane used by this root port. If omitted, the
          root-port number is used.

      apple,manual-availability-iommu:
        $ref: /schemas/types.yaml#/definitions/phandle-array
        items:
          - items:
              - description: phandle of the DART
              - description: stream ID
        description:
          DART and stream whose retained configuration must be reloaded while
          this root port is brought up. This models Apple's manual-availability
          lifecycle before the endpoint is released from reset.

      apple,link-retry-after-power-cycle:
        type: boolean
        description:
          Retry this root port once after cycling endpoint power when the first
          complete port-enable lifecycle does not make the link usable.

      apple,hardware-trained-phy-lane:
        type: boolean
        description:
          The PHY lane enters its calibrated operating state as part of
          enabling the root port. Static lane initialization values must not be
          applied after the port-enable sequence because that would overwrite
          the hardware-trained state.

      apple,endpoint-power-after-link-setup:
        type: boolean
        description:
          Keep the endpoint power control disabled through the initial root-port
          setup, then complete link-event configuration before enabling it.
          The controller observes link state only after the endpoint power
          control has completed its stabilization interval and before the
          endpoint is released from reset.

      apple,inherited-perst-before-link-setup:
        type: boolean
        description:
          Preserve PERST# as an input during the first root-port setup instead
          of actively asserting it. A single power-cycle retry uses the normal
          asserted output state.

    required:
      - reg
      - reset-gpios

    additionalProperties: true

required:
  - compatible
  - reg
  - reg-names
  - interrupts
  - interrupt-names
  - power-domains
  - bus-range
  - ranges
  - msi-controller
  - msi-parent
  - msi-ranges
  - '#interrupt-cells'

unevaluatedProperties: false

examples:
  - |
    #include <dt-bindings/gpio/gpio.h>
    #include <dt-bindings/interrupt-controller/apple-aic.h>

    / {
        #address-cells = <2>;
        #size-cells = <2>;

        aliases {
            nvme-hmb = &nvme_hmb;
        };

        aic: interrupt-controller {
            interrupt-controller;
            #interrupt-cells = <3>;
        };

        reserved-memory {
            #address-cells = <2>;
            #size-cells = <2>;
            ranges;

            nvme_hmb: nvme-hmb@0 {
                reg = <0x0 0x0 0x0 0x0>; /* To be filled by loader */
                no-map;
            };
        };

        soc {
            #address-cells = <2>;
            #size-cells = <2>;

            pcie0: pcie@610000000 {
                compatible = "apple,t8010-pcie";
                device_type = "pci";

                reg = <0x6 0x10000000 0x0 0x1000000>,
                      <0x6 0x00000000 0x0 0x8000>,
                      <0x6 0x00008000 0x0 0x4000>,
                      <0x6 0x0a000000 0x0 0x40000>,
                      <0x6 0x01000000 0x0 0x4000>,
                      <0x6 0x02000000 0x0 0x4000>,
                      <0x6 0x03000000 0x0 0x4000>,
                      <0x6 0x04000000 0x0 0x4000>,
                      <0x6 0x01004000 0x0 0x4000>;
                reg-names = "config", "rc", "phy", "phy-ip",
                            "port0", "port1", "port2", "port3",
                            "nvmmu";

                interrupt-parent = <&aic>;
                interrupts = <AIC_IRQ 270 IRQ_TYPE_LEVEL_HIGH>,
                             <AIC_IRQ 273 IRQ_TYPE_LEVEL_HIGH>,
                             <AIC_IRQ 276 IRQ_TYPE_LEVEL_HIGH>,
                             <AIC_IRQ 279 IRQ_TYPE_LEVEL_HIGH>,
                             <AIC_IRQ 272 IRQ_TYPE_EDGE_RISING>;
                interrupt-names = "port0", "port1", "port2", "port3",
                                  "nvmmu";

                msi-controller;
                msi-parent = <&pcie0>;
                msi-ranges = <&aic AIC_IRQ 288 IRQ_TYPE_EDGE_RISING 32>;
                apple,msi-doorbell = <0xbffff000>;
                apple,nvmmu-iova = <0xbc000000>;
                apple,nvme-hmb = <&nvme_hmb>;

                #address-cells = <3>;
                #size-cells = <2>;
                #interrupt-cells = <1>;
                interrupt-controller;
                bus-range = <0x00 0x0f>;
                ranges = <0x03000000 0x0 0xc0000000
                          0x7 0xc0000000 0x0 0x40000000>;

                clocks = <&clkref>, <&clkref>;
                clock-names = "aux", "ref";
                power-domains = <&ps_pcie>;

                pci@0,0 {
                    device_type = "pci";
                    reg = <0x0 0x0 0x0 0x0 0x0>;
                    reset-gpios = <&pinctrl_ap 12 GPIO_ACTIVE_LOW>;
                    clkreq-gpios = <&pinctrl_ap 16 GPIO_ACTIVE_LOW>;

                    #address-cells = <3>;
                    #size-cells = <2>;
                    ranges;
                };
            };
        };
    };


  - |
    #include <dt-bindings/gpio/gpio.h>
    #include <dt-bindings/interrupt-controller/apple-aic.h>

    soc {
        #address-cells = <2>;
        #size-cells = <2>;

        pcie: pcie@610000000 {
            compatible = "apple,t7000-pcie";
            device_type = "pci";

            reg = <0x6 0x10000000 0x0 0x1000000>,
                  <0x6 0x00000000 0x0 0x2000>,
                  <0x6 0x01004000 0x0 0x1000>,
                  <0x6 0x02004000 0x0 0x1000>,
                  <0x6 0x03004000 0x0 0x1000>,
                  <0x6 0x04004000 0x0 0x1000>;
            reg-names = "config", "rc", "port0", "port1", "port2", "port3";

            interrupt-parent = <&aic>;
            interrupts = <AIC_IRQ 212 IRQ_TYPE_LEVEL_HIGH>,
                         <AIC_IRQ 215 IRQ_TYPE_LEVEL_HIGH>,
                         <AIC_IRQ 218 IRQ_TYPE_LEVEL_HIGH>,
                         <AIC_IRQ 221 IRQ_TYPE_LEVEL_HIGH>;
            interrupt-names = "port0", "port1", "port2", "port3";

            msi-controller;
            msi-parent = <&pcie>;
            msi-ranges = <&aic AIC_IRQ 224 IRQ_TYPE_EDGE_RISING 32>;
            apple,msi-doorbell = <0xbffff000>;

            iommu-map = <0x100 &dart_apcie1 0 0x0 0x80000000 0x0 0x3ffff000 1>;
            iommu-map-mask = <0xff00>;

            #address-cells = <3>;
            #size-cells = <2>;
            #interrupt-cells = <1>;
            interrupt-controller;
            bus-range = <0x00 0x04>;
            ranges = <0x02000000 0x0 0xc0000000
                      0x7 0xc0000000 0x0 0x40000000>;

            power-domains = <&ps_pcie>, <&ps_pcie_ref>, <&ps_pcie_aux>;

            pci@1,0 {
                device_type = "pci";
                reg = <0x800 0x0 0x0 0x0 0x0>;
                reset-gpios = <&pinctrl 179 GPIO_ACTIVE_LOW>;
                max-link-speed = <1>;

                #address-cells = <3>;
                #size-cells = <2>;
                ranges;
            };
        };
    };
...
```

## Documentation/devicetree/bindings/power/reset/apple,d2365-poweroff.yaml
```yaml
# SPDX-License-Identifier: GPL-2.0-only OR BSD-2-Clause
%YAML 1.2
---
$id: http://devicetree.org/schemas/power/reset/apple,d2365-poweroff.yaml#
$schema: http://devicetree.org/meta-schemas/core.yaml#

title: Apple D2365 PMIC power off

maintainers:
  - Stuart Fraser <me@stuartfraser.ca>

description: |
  The D2365 (Angel) PMIC can enter standby through its I2C register map.
  This child of the PMIC describes boards using the PMIC's direct shutdown
  sequence, not a separate external shutdown controller. Such boards restart
  instead of entering standby while external power is connected. The supply
  reference identifies the board's external power source.

properties:
  compatible:
    const: apple,d2365-poweroff

  power-supplies:
    $ref: /schemas/types.yaml#/definitions/phandle-array
    maxItems: 1
    description: |
      External USB or charger power supply provided by a sibling child of
      the same PMIC. Its cached state complements the direct PMIC source check.

required:
  - compatible
  - power-supplies

additionalProperties: false

examples:
  - |
    i2c {
        #address-cells = <1>;
        #size-cells = <0>;

        pmic@3c {
            compatible = "apple,angel-pmic", "apple,i2c-pmic";
            reg = <0x3c>;
            #address-cells = <1>;
            #size-cells = <1>;

            poweroff {
                compatible = "apple,d2365-poweroff";
                power-supplies = <&tristar_charger>;
            };
        };
    };
```
