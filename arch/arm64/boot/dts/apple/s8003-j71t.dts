// SPDX-License-Identifier: GPL-2.0+ OR MIT
/*
 * Apple iPad 5 (Wi-Fi) (TSMC), J71t, iPad6,11 (A1822)
 * Copyright (c) 2022, Konrad Dybcio <konradybcio@kernel.org>
 */

/dts-v1/;

#define S800X_IPAD5_PCIE

#include "s8003.dtsi"
#include "s800x-ipad5.dtsi"

/ {
	compatible = "apple,j71t", "apple,s8003", "apple,arm-platform";
	model = "Apple iPad 5 (Wi-Fi) (TSMC)";
};

&touchscreen {
	firmware-name = "apple/j71t-fwstart.z2fw";
};

/* ADT uart2/wlan module-instance */
&wifi {
	brcm,board-type = "apple,feara";
};
